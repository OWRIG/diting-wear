## CMakeLists.txt
```
cmake_minimum_required(VERSION 3.20.0)
find_package(Zephyr REQUIRED HINTS $ENV{ZEPHYR_BASE})
project(recorder)

include(${CMAKE_CURRENT_SOURCE_DIR}/../lib/opus.cmake)

target_sources(app PRIVATE src/main.c src/audio.c src/ble.c src/battery.c)
target_link_libraries(app PRIVATE opus)
```

## prj.conf
```kconfig
# ---- 基础 ----
CONFIG_PRINTK=y
CONFIG_GPIO=y
CONFIG_LOG=y
CONFIG_MAIN_STACK_SIZE=4096

# ---- 麦克风 ----
CONFIG_AUDIO=y
CONFIG_AUDIO_DMIC=y

# ---- 蓝牙 ----
CONFIG_BT=y
CONFIG_BT_PERIPHERAL=y
CONFIG_BT_DEVICE_NAME="RIG DAY LIFE INPUT (VOICE)"
CONFIG_BT_MAX_CONN=1
# 大包：一次通知能带一整帧 Opus
CONFIG_BT_L2CAP_TX_MTU=247
CONFIG_BT_BUF_ACL_TX_SIZE=251
CONFIG_BT_BUF_ACL_RX_SIZE=251
CONFIG_BT_CTLR_DATA_LENGTH_MAX=251
CONFIG_BT_BUF_ACL_TX_COUNT=10
CONFIG_BT_CONN_TX_MAX=10
CONFIG_BT_GAP_AUTO_UPDATE_CONN_PARAMS=y
CONFIG_BT_PERIPHERAL_PREF_MIN_INT=12
CONFIG_BT_PERIPHERAL_PREF_MAX_INT=24
CONFIG_BT_PERIPHERAL_PREF_LATENCY=0
CONFIG_BT_PERIPHERAL_PREF_TIMEOUT=400
CONFIG_BT_USER_DATA_LEN_UPDATE=y
CONFIG_BT_USER_PHY_UPDATE=y

# ---- Opus 需要较大的栈和堆 ----
CONFIG_HEAP_MEM_POOL_SIZE=32768
CONFIG_FPU=y
CONFIG_BT_BUF_EVT_RX_COUNT=12

# ---- 电池电压 ----
CONFIG_ADC=y
CONFIG_REGULATOR=y
```

## app.overlay
```dts
/* 电池电压：ADC 通道 7 (P1.14)，经过 1/2 分压；vbat_pwr 负载开关控制分压电路的通断 */
/ {
	zephyr,user {
		io-channels = <&adc 7>;
	};
};
```

## src/main.c
```c
/* 全天语音记录器 —— 录音 + Opus 编码 + BLE 实时发送 */
#include <zephyr/kernel.h>
#include "app.h"

int main(void)
{
	printk("\n=== RIG recorder start ===\n");
	if (ble_init() != 0) {
		printk("ERROR: BLE init failed\n");
		return 0;
	}
	audio_start();
	return 0;
}
```

## src/agc.c
```c
/*
 * 音频前处理：80Hz 高通滤波 + 自动增益控制（AGC）+ 峰值限制。
 *
 * - 高通：二阶巴特沃斯，去掉直流、走路震动、衣服摩擦、空调等低频轰鸣（人声基本在 100Hz 以上）。
 * - AGC：只在"像是有人在说话"的帧上调整增益（帧能量比噪声底高 12dB 以上），安静时保持不动，
 *        这样不会把底噪越放越大。变响时快速降增益，变轻时慢慢升（≤ 6dB/秒）。
 * - 峰值限制：放大后若峰值超过 -1dBFS，就立即把这一帧的增益压到刚好不削波；
 *        帧内从上一帧的增益线性过渡到新增益，避免咔哒声。
 */
#include <math.h>
#include <zephyr/sys/util.h>
#include "agc.h"
#include "app.h"

#define HPF_HZ          80.0f
#define TARGET_DBFS     (-28.0f)   /* 说话时希望达到的帧 RMS */
#define GAIN_MIN_DB     0.0f
#define GAIN_MAX_DB     20.0f
#define GAIN_INIT_DB    12.0f      /* 以前固定 ×4 */
#define RISE_DB_PER_FR  (6.0f * FRAME_MS / 1000.0f)   /* 升增益最快 6dB/秒 */
#define FALL_DB_PER_FR  (3.0f)                       /* 降增益很快 */
#define SPEECH_OVER_NF_DB 12.0f
#define PEAK_LIMIT      (0.89f * 32767.0f)          /* -1dBFS */

static float b0, b1, b2, a1, a2;     /* 高通系数 */
static float hx1, hx2, hy1, hy2;     /* 高通状态 */
static float gain_db = GAIN_INIT_DB;
static float gain_lin_prev;
static float noise_db = -60.0f;
static uint32_t limited;
static float buf[FRAME_SAMPLES];

void agc_init(void)
{
	/* RBJ cookbook 高通，Q = 1/sqrt(2) */
	float w0 = 2.0f * 3.14159265f * HPF_HZ / SAMPLE_RATE;
	float alpha = sinf(w0) / (2.0f * 0.70710678f);
	float c = cosf(w0), a0 = 1.0f + alpha;
	b0 = (1.0f + c) / 2.0f / a0;
	b1 = -(1.0f + c) / a0;
	b2 = (1.0f + c) / 2.0f / a0;
	a1 = -2.0f * c / a0;
	a2 = (1.0f - alpha) / a0;
	hx1 = hx2 = hy1 = hy2 = 0;
	gain_db = GAIN_INIT_DB;
	gain_lin_prev = powf(10.0f, gain_db / 20.0f);
}

static inline float db(float lin)
{
	return 20.0f * log10f(lin + 1e-9f);
}

void agc_process(int16_t *pcm, int n)
{
	n = MIN(n, FRAME_SAMPLES);

	/* 1. 高通，同时求能量和峰值 */
	float sum_sq = 0, peak = 0;
	for (int i = 0; i < n; i++) {
		float x = pcm[i];
		float y = b0 * x + b1 * hx1 + b2 * hx2 - a1 * hy1 - a2 * hy2;
		hx2 = hx1; hx1 = x; hy2 = hy1; hy1 = y;
		buf[i] = y;
		sum_sq += y * y;
		float a = fabsf(y);
		if (a > peak) {
			peak = a;
		}
	}
	float rms_db = db(sqrtf(sum_sq / n) / 32768.0f);

	/* 2. 噪声底：跟踪最小值，下降很快、上升很慢（约 1dB/秒） */
	if (rms_db < noise_db) {
		noise_db = rms_db;
	} else {
		noise_db += 1.0f * FRAME_MS / 1000.0f;
	}

	/* 3. 只在说话帧上调整增益 */
	if (rms_db > noise_db + SPEECH_OVER_NF_DB && rms_db > -75.0f) {
		float want = CLAMP(TARGET_DBFS - rms_db, GAIN_MIN_DB, GAIN_MAX_DB);
		if (want > gain_db) {
			gain_db = MIN(want, gain_db + RISE_DB_PER_FR);
		} else {
			gain_db = MAX(want, gain_db - FALL_DB_PER_FR);
		}
	}

	/* 4. 峰值限制：这一帧放大后不能超过 -1dBFS */
	float g = powf(10.0f, gain_db / 20.0f);
	if (peak * g > PEAK_LIMIT) {
		g = PEAK_LIMIT / peak;
		gain_db = db(g);          /* 记住压低后的增益，之后再慢慢升回来 */
		limited++;
	}

	/* 5. 帧内从上一帧增益平滑过渡到这一帧增益 */
	float step = (g - gain_lin_prev) / n;
	float cur = gain_lin_prev;
	for (int i = 0; i < n; i++) {
		cur += step;
		float v = buf[i] * cur;
		pcm[i] = (int16_t)CLAMP(lrintf(v), -32768, 32767);
	}
	gain_lin_prev = g;
}

float agc_gain_db(void) { return gain_db; }
float agc_noise_db(void) { return noise_db; }
uint32_t agc_limited_frames(void) { return limited; }
```

## src/agc.h
```c
#pragma once
#include <stdint.h>

/* 80Hz 高通 + 自动增益（带峰值限制），原地处理一帧 16-bit PCM */
void agc_init(void);
void agc_process(int16_t *pcm, int n);

/* 统计（给串口打印用） */
float agc_gain_db(void);
float agc_noise_db(void);
uint32_t agc_limited_frames(void);   /* 因为峰值而被压低增益的帧数 */
```

## src/app.h
```c
#pragma once
#include <stdint.h>
#include <stdbool.h>
#include <stddef.h>

/* 采样参数 */
#define SAMPLE_RATE    16000
#define FRAME_MS       20
#define FRAME_SAMPLES  (SAMPLE_RATE * FRAME_MS / 1000)   /* 320 */
#define OPUS_BITRATE   16000
#define OPUS_MAX_BYTES 120

/* ble.c */
int ble_init(void);
bool ble_streaming(void);              /* 已连接且手机订阅了音频 */
/* 发一帧音频，seq 是帧序号（每 20ms 加一，安静没发的帧也算）。
 * len == 0 表示"安静声明"：seq 以及之前没收到的帧都是安静，手机用静音补上 */
int ble_send_audio(uint16_t seq, const uint8_t *data, size_t len);

/* ble.c 电池 */
int ble_send_battery(uint16_t mv);

/* battery.c */
uint16_t battery_mv(void);

/* audio.c */
void audio_start(void);
```

## src/audio.c
```c
/* 音频：PDM 麦克风 16kHz → 高通 + 自动增益 → Opus 编码 → BLE 发送。
 * 只在手机订阅了音频时才开麦，省电。
 *
 * 安静时不编码、不发送（省设备和手机的电）：
 * - 每帧都过 AGC，顺便判断"有没有声音"；最近 10 帧里有 3 帧有声音就开始发送
 * - 开始发送时，把之前缓存的 0.4 秒也补发出去，免得丢掉第一个字
 * - 最后一次有声音后再继续发 3 秒，免得把句子中间的停顿切掉
 * - 不发送期间，每秒发一个只有帧序号的"安静声明"，手机据此用静音补齐，时间线不乱
 */
#include <zephyr/kernel.h>
#include <zephyr/audio/dmic.h>
#include <zephyr/drivers/gpio.h>
#include <opus.h>
#include "app.h"
#include "agc.h"

#define BLOCK_BYTES  (FRAME_SAMPLES * 2)
#define BLOCK_COUNT  16                   /* 16 × 20ms = 320ms 缓冲（开口时要一口气编码缓存的帧） */
#define PREROLL      20                   /* 开口前补发 0.4 秒 */
#define HANG         150                  /* 声音停了以后再发 3 秒 */
#define ONSET_WIN    10                   /* 最近 10 帧里 */
#define ONSET_MIN    3                    /* 有 3 帧有声音就开始发 */
#define KEEPALIVE    50                   /* 安静时每 1 秒声明一次 */
#define STATS_EVERY  250                  /* 每 250 帧 (5 秒) 打印一次统计 */

K_MEM_SLAB_DEFINE_STATIC(pcm_slab, BLOCK_BYTES, BLOCK_COUNT, 4);

static const struct gpio_dt_spec led = GPIO_DT_SPEC_GET(DT_ALIAS(led0), gpios);
static const struct device *dmic = DEVICE_DT_GET(DT_NODELABEL(dmic_dev));

static uint8_t enc_mem[28 * 1024] __aligned(8);
static int16_t ring[PREROLL][FRAME_SAMPLES];   /* 最近 0.4 秒处理过的 PCM，按帧号取模存放 */
static OpusEncoder *enc;

static int mic_config(void)
{
	static struct pcm_stream_cfg stream = {
		.pcm_rate = SAMPLE_RATE, .pcm_width = 16,
		.block_size = BLOCK_BYTES, .mem_slab = &pcm_slab,
	};
	struct dmic_cfg cfg = {
		.io = { .min_pdm_clk_freq = 1000000, .max_pdm_clk_freq = 3500000,
			.min_pdm_clk_dc = 40, .max_pdm_clk_dc = 60 },
		.streams = &stream,
		.channel = { .req_num_streams = 1, .req_num_chan = 1,
			     .req_chan_map_lo = dmic_build_channel_map(0, 0, PDM_CHAN_LEFT) },
	};
	return dmic_configure(dmic, &cfg);
}

static int encoder_init(void)
{
	int size = opus_encoder_get_size(1);
	printk("opus encoder size: %d bytes\n", size);
	if (size > sizeof(enc_mem)) {
		return -ENOMEM;
	}
	enc = (OpusEncoder *)enc_mem;
	int err = opus_encoder_init(enc, SAMPLE_RATE, 1, OPUS_APPLICATION_VOIP);
	if (err != OPUS_OK) {
		return err;
	}
	opus_encoder_ctl(enc, OPUS_SET_BITRATE(OPUS_BITRATE));
	opus_encoder_ctl(enc, OPUS_SET_VBR(1));
	opus_encoder_ctl(enc, OPUS_SET_COMPLEXITY(1));
	opus_encoder_ctl(enc, OPUS_SET_SIGNAL(OPUS_SIGNAL_VOICE));
	opus_encoder_ctl(enc, OPUS_SET_BANDWIDTH(OPUS_BANDWIDTH_WIDEBAND));
	return 0;
}

static void drain_mic(void)
{
	void *buf;
	uint32_t size;

	while (dmic_read(dmic, 0, &buf, &size, 0) == 0) {
		k_mem_slab_free(&pcm_slab, buf);
	}
}

static int encode_send(uint32_t seq, uint8_t *out, uint32_t *bytes, uint32_t *enc_us_sum, uint32_t *enc_us_max)
{
	uint32_t t0 = k_cycle_get_32();
	int n = opus_encode(enc, ring[seq % PREROLL], FRAME_SAMPLES, out, OPUS_MAX_BYTES);
	uint32_t us = k_cyc_to_us_floor32(k_cycle_get_32() - t0);

	if (n < 0) {
		printk("opus error %d\n", n);
		return n;
	}
	*bytes += n;
	*enc_us_sum += us;
	*enc_us_max = MAX(*enc_us_max, us);
	return ble_send_audio((uint16_t)seq, out, n);
}

static void stream_session(void)
{
	uint8_t out[OPUS_MAX_BYTES];
	uint32_t frames = 0, sent = 0, sent_period = 0, bytes = 0, send_err = 0, enc_us_sum = 0, enc_us_max = 0;
	uint32_t seq = 0;          /* 下一帧的帧号（32 位，发出去时取低 16 位） */
	uint32_t next_open = 0;    /* 第一个既没发送、也没声明为安静的帧 */
	uint32_t last_ka = 0;
	uint16_t hist = 0;         /* 最近 ONSET_WIN 帧有没有声音，一位一帧 */
	int hang = 0;              /* > 0 表示正在发送 */

	if (dmic_trigger(dmic, DMIC_TRIGGER_START) < 0) {
		printk("ERROR: mic start failed\n");
		k_msleep(1000);
		return;
	}
	agc_init();
	opus_encoder_ctl(enc, OPUS_RESET_STATE);
	gpio_pin_set_dt(&led, 1);
	printk("mic ON\n");

	while (ble_streaming()) {
		void *buf;
		uint32_t size;

		if (dmic_read(dmic, 0, &buf, &size, 500) < 0) {
			printk("mic read timeout\n");
			continue;
		}
		agc_process(buf, size / 2);
		bool v = agc_voice();
		uint32_t cur = seq++;
		memcpy(ring[cur % PREROLL], buf, FRAME_SAMPLES * 2);
		k_mem_slab_free(&pcm_slab, buf);
		frames++;
		hist = ((hist << 1) | v) & ((1u << ONSET_WIN) - 1);

		if (hang > 0) {
			/* 正在发送 */
			if (encode_send(cur, out, &bytes, &enc_us_sum, &enc_us_max) != 0) {
				send_err++;
			}
			sent++;
			sent_period++;
			next_open = cur + 1;
			hang = v ? HANG : hang - 1;
		} else if (__builtin_popcount(hist) >= ONSET_MIN) {
			/* 开口了：先声明缓存之前的帧是安静，再把缓存的帧和这一帧发出去 */
			uint32_t start = cur + 1 > PREROLL ? cur + 1 - PREROLL : 0;
			start = MAX(start, next_open);
			if (start > next_open) {
				ble_send_audio((uint16_t)(start - 1), NULL, 0);
			}
			opus_encoder_ctl(enc, OPUS_RESET_STATE);
			for (uint32_t s = start; s <= cur; s++) {
				if (encode_send(s, out, &bytes, &enc_us_sum, &enc_us_max) != 0) {
					send_err++;
				}
				sent++;
				sent_period++;
			}
			next_open = cur + 1;
			hang = HANG;
		} else if (cur - last_ka >= KEEPALIVE && cur + 1 > PREROLL) {
			/* 安静：声明到缓存之前为止都是安静（缓存里的帧可能还要补发） */
			uint32_t upto = cur + 1 - PREROLL - 1;
			if (upto + 1 > next_open) {
				ble_send_audio((uint16_t)upto, NULL, 0);
				next_open = upto + 1;
			}
			last_ka = cur;
		}

		if (frames % STATS_EVERY == 0) {
			printk("[stats] %u frames, sent %u%%, %u B/s, encode avg %u us max %u us, send errors %u, "
			       "gain %d dB, noise %d dBFS, limited %u\n",
			       frames, sent * 100 / frames, bytes * 1000 / (STATS_EVERY * FRAME_MS),
			       enc_us_sum / MAX(1, sent_period), enc_us_max, send_err,
			       (int)agc_gain_db(), (int)agc_noise_db(), agc_limited_frames());
			bytes = enc_us_sum = enc_us_max = sent_period = 0;
		}
	}

	dmic_trigger(dmic, DMIC_TRIGGER_STOP);
	drain_mic();
	gpio_pin_set_dt(&led, 0);
	printk("mic OFF\n");
}

static void audio_thread(void *a, void *b, void *c)
{
	gpio_pin_configure_dt(&led, GPIO_OUTPUT_INACTIVE);

	if (!device_is_ready(dmic) || mic_config() < 0) {
		printk("ERROR: mic init failed\n");
		return;
	}
	if (encoder_init() != 0) {
		printk("ERROR: opus init failed\n");
		return;
	}
	printk("audio ready, waiting for phone to subscribe\n");

	for (;;) {
		if (ble_streaming()) {
			stream_session();
		} else {
			k_msleep(100);
		}
	}
}

/* Opus 用变长数组放在栈上，需要较大的栈 */
K_THREAD_STACK_DEFINE(audio_stack, 32 * 1024);
static struct k_thread audio_tid;

void audio_start(void)
{
	k_thread_create(&audio_tid, audio_stack, K_THREAD_STACK_SIZEOF(audio_stack),
			audio_thread, NULL, NULL, NULL, 5, K_FP_REGS, K_NO_WAIT);
}
```

## src/ble.c
```c
/* BLE：自定义音频服务，一条 notify 特征发送 Opus 帧。
 * 每个通知包格式: [seq 低字节][seq 高字节][一帧 Opus 数据]
 */
#include <zephyr/kernel.h>
#include <zephyr/bluetooth/bluetooth.h>
#include <zephyr/bluetooth/conn.h>
#include <zephyr/bluetooth/gatt.h>
#include <zephyr/bluetooth/uuid.h>
#include <string.h>
#include <zephyr/sys/byteorder.h>
#include "app.h"

/* 服务 UUID: 5a1d0001-7e3c-4b8a-9f00-524947000000 */
#define RIG_UUID(n) BT_UUID_128_ENCODE(0x5a1d0000 | (n), 0x7e3c, 0x4b8a, 0x9f00, 0x524947000000)
static const struct bt_uuid_128 svc_uuid   = BT_UUID_INIT_128(RIG_UUID(1));
static const struct bt_uuid_128 audio_uuid = BT_UUID_INIT_128(RIG_UUID(2));
/* 电池特征 5a1d0003-…：uint16 小端，单位 mV，可读 + 通知 */
static const struct bt_uuid_128 batt_uuid  = BT_UUID_INIT_128(RIG_UUID(3));

static struct bt_conn *cur_conn;
static volatile bool subscribed;

static volatile bool batt_subscribed;

static void batt_ccc_changed(const struct bt_gatt_attr *attr, uint16_t value)
{
	batt_subscribed = (value == BT_GATT_CCC_NOTIFY);
}

static ssize_t batt_read(struct bt_conn *conn, const struct bt_gatt_attr *attr,
			 void *buf, uint16_t len, uint16_t offset)
{
	uint16_t mv = sys_cpu_to_le16(battery_mv());
	return bt_gatt_attr_read(conn, attr, buf, len, offset, &mv, sizeof(mv));
}

static void ccc_changed(const struct bt_gatt_attr *attr, uint16_t value)
{
	subscribed = (value == BT_GATT_CCC_NOTIFY);
	printk("audio notify %s\n", subscribed ? "ON" : "OFF");
}

BT_GATT_SERVICE_DEFINE(rig_svc,
	BT_GATT_PRIMARY_SERVICE(&svc_uuid),
	BT_GATT_CHARACTERISTIC(&audio_uuid.uuid, BT_GATT_CHRC_NOTIFY,
			       BT_GATT_PERM_NONE, NULL, NULL, NULL),
	BT_GATT_CCC(ccc_changed, BT_GATT_PERM_READ | BT_GATT_PERM_WRITE),
	BT_GATT_CHARACTERISTIC(&batt_uuid.uuid, BT_GATT_CHRC_READ | BT_GATT_CHRC_NOTIFY,
			       BT_GATT_PERM_READ, batt_read, NULL, NULL),
	BT_GATT_CCC(batt_ccc_changed, BT_GATT_PERM_READ | BT_GATT_PERM_WRITE),
);

static const struct bt_data ad[] = {
	BT_DATA_BYTES(BT_DATA_FLAGS, (BT_LE_AD_GENERAL | BT_LE_AD_NO_BREDR)),
	BT_DATA_BYTES(BT_DATA_UUID128_ALL, RIG_UUID(1)),
};
static const struct bt_data sd[] = {
	BT_DATA(BT_DATA_NAME_COMPLETE, CONFIG_BT_DEVICE_NAME, sizeof(CONFIG_BT_DEVICE_NAME) - 1),
};

static struct k_work adv_work;

static void adv_start(struct k_work *w)
{
	int err = bt_le_adv_start(BT_LE_ADV_CONN_FAST_2, ad, ARRAY_SIZE(ad), sd, ARRAY_SIZE(sd));
	if (err && err != -EALREADY) {
		printk("adv start failed: %d\n", err);
	} else {
		printk("advertising\n");
	}
}

static void connected(struct bt_conn *conn, uint8_t err)
{
	if (err) {
		printk("connect failed: %u\n", err);
		return;
	}
	cur_conn = bt_conn_ref(conn);
	printk("connected\n");

	/* 请求 2M PHY 和长数据包，省电又提速 */
	bt_conn_le_phy_update(conn, BT_CONN_LE_PHY_PARAM_2M);
	struct bt_conn_le_data_len_param dl = { .tx_max_len = 251, .tx_max_time = 2120 };
	bt_conn_le_data_len_update(conn, &dl);
}

static void disconnected(struct bt_conn *conn, uint8_t reason)
{
	printk("disconnected (reason %u)\n", reason);
	subscribed = false;
	if (cur_conn) {
		bt_conn_unref(cur_conn);
		cur_conn = NULL;
	}
}

static void recycled(void)
{
	k_work_submit(&adv_work);
}

static void param_updated(struct bt_conn *conn, uint16_t interval, uint16_t latency, uint16_t timeout)
{
	printk("conn params: interval %u.%02u ms, latency %u\n",
	       interval * 125 / 100, (interval * 125) % 100, latency);
}

BT_CONN_CB_DEFINE(conn_cb) = {
	.connected = connected,
	.disconnected = disconnected,
	.recycled = recycled,
	.le_param_updated = param_updated,
};

static void mtu_updated(struct bt_conn *conn, uint16_t tx, uint16_t rx)
{
	printk("MTU: tx %u rx %u\n", tx, rx);
}

static struct bt_gatt_cb gatt_cb = { .att_mtu_updated = mtu_updated };

int ble_init(void)
{
	int err = bt_enable(NULL);
	if (err) {
		return err;
	}
	bt_gatt_cb_register(&gatt_cb);
	k_work_init(&adv_work, adv_start);
	k_work_submit(&adv_work);
	return 0;
}

bool ble_streaming(void)
{
	return cur_conn && subscribed;
}

int ble_send_audio(uint16_t seq, const uint8_t *data, size_t len)
{
	uint8_t pkt[2 + OPUS_MAX_BYTES];

	if (!ble_streaming() || len > OPUS_MAX_BYTES) {
		return -ENOTCONN;
	}
	if (len + 2 > bt_gatt_get_mtu(cur_conn) - 3) {
		return -EMSGSIZE;   /* MTU 还没协商大 */
	}
	pkt[0] = seq & 0xff;
	pkt[1] = seq >> 8;
	if (len) {
		memcpy(&pkt[2], data, len);
	}
	/* 一开口时会连发十几帧（提前缓存的部分），发送缓冲可能暂时满，稍等重试 */
	int err;
	for (int i = 0; i < 20; i++) {
		err = bt_gatt_notify(cur_conn, &rig_svc.attrs[1], pkt, len + 2);
		if (err != -ENOMEM && err != -ENOBUFS) {
			break;
		}
		k_msleep(5);
	}
	return err;
}

int ble_send_battery(uint16_t mv)
{
	if (!cur_conn || !batt_subscribed) {
		return -ENOTCONN;
	}
	uint16_t v = sys_cpu_to_le16(mv);
	return bt_gatt_notify(cur_conn, &rig_svc.attrs[4], &v, sizeof(v));
}
```
